#include <dt-bindings/zmk/matrix_transform.h>

#include "Macro3x3-layouts.dtsi"

/ {

    encoder: encoder {
        compatible = "alps,ec11";
        steps = <80>;
        status = "disabled";
    };


    sensors: sensors {
        compatible = "zmk,keymap-sensors";
        sensors = <&encoder>;
        triggers-per-rotation = <20>;
    };
};